## kernel/drivers/gpu/drm/samsung/panel/s6e3fae/Kconfig
```kconfig
menuconfig USDM_PANEL_S6E3FAE
	tristate "S6E3FAE DDI Panel Driver"
	depends on USDM_PANEL
	depends on USDM_PANEL_OLED_COMMON
	default n
	help
		This enables S6E3FAE DDI dependent panel drivers of
		common panel driver. say Y, if you have a panel based on
		the S6E3FAE DDI.


########## FOR KUNIT ##########

config S6E3FAE_TEST
	bool "KUnit test for s6e3fae ddi driver"
	depends on SEC_KUNIT
	help
	  TODO: Describe config fully.

config S6E3FAE_COPR_TEST
	bool "KUnit test for s6e3fae ddi copr driver"
	depends on SEC_KUNIT && USDM_PANEL_COPR
	help
	  TODO: Describe config fully.

config S6E3FAE_MDNIE_TEST
	bool "KUnit test for s6e3fae ddi mdnie driver"
	depends on SEC_KUNIT && USDM_MDNIE
	help
	  TODO: Describe config fully.

config S6E3FAE_MAFPC_TEST
	bool "KUnit test for s6e3fae ddi mafpc driver"
	depends on SEC_KUNIT && USDM_PANEL_MAFPC
	help
	  TODO: Describe config fully.

config S6E3FAE_FAC_TEST
	bool "KUnit test for s6e3fae ddi factory mode driver"
	depends on SEC_KUNIT
	help
	  TODO: Describe config fully.

config S6E3FAE_AOD_TEST
	bool "KUnit test for s6e3fae ddi aod driver"
	depends on SEC_KUNIT && USDM_PANEL_LPM
	help
	  TODO: Describe config fully.



########## FOR KUNIT ##########

config S6E3FAE_E1S_TEST
	bool "KUnit test for s6e3fae_e1s ddi driver"
	depends on SEC_KUNIT
	help
	  TODO: Describe config fully.
```
